## main/Kconfig.projbuild
```kconfig
menu "DroneBridge for ESP32 Configuration"

    choice
        prompt "ESP32 board type"
        default DB_GENERIC_BOARD
        help
            Select the DroneBridge ESP32 board type.
            Depending on the chosen option the UART pins will be pre-configured (official boards) or not (generic boards)
        config DB_GENERIC_BOARD
            bool "Generic ESP32 board (no pre-configuration)"
            help
                For all types of ESP32 boards. UART pins must be set in the web interface.
                If in doubt choose this option.
        config DB_OFFICIAL_BOARD_1_X
            bool "Official DroneBridge for ESP32 HWv1.x ESP32-C3 board"
            help
                The correct UART pins are set as defaults. No need to configure them manually.
                Choose this if you have the official DroneBridge for ESP32 HWv1.x board with an ESP32-C3.
        config DB_OFFICIAL_BOARD_1_X_C6
            bool "Official DroneBridge for ESP32 HWv1.x ESP32-C6 board"
            select DB_HAS_RF_SWITCH
            help
                The correct UART pins are set as defaults. No need to configure them manually.
                Choose this if you have the official DroneBridge for ESP32 HWv1.x board with an ESP32-C6.
                Enables RF switch via GPIO 13 and antenna selection on GPIO 14
    endchoice

    config DB_HAS_RF_SWITCH
        bool "Enable support for an external antenna/RF switch"
        default n
        depends on !DB_OFFICIAL_BOARD_1_X
        help
            Enable this option to allow the use of an external antenna switch (need to configure GPIO).
            The UI will then allow you to choose between antennas. At the moment only two antennas are supported.
            Beware that for some boards the antenna switch sometimes must be activated first by setting a GPIO.
            Do that in code. Enabling of the switch is done automatically for the official HW 1.x based on the ESP32C6.

    config DB_RF_SWITCH_GPIO
        int "Define pin to use for switching between external and internal antenna"
        depends on DB_HAS_RF_SWITCH
        default 14 if DB_OFFICIAL_BOARD_1_X_C6
        default 0
        help
            This GPIOs high/low state is used to indicate to the RF switch what antenna to choose.
            Official HW v1.x ESP32-C6 boards use GPIO 14.
            Set to 0 equals not configured.

    choice
        prompt "Serial interface for data."
        default DB_SERIAL_OPTION_UART
        help
            Select serial interface.
            USB/JTAG on the official HWv1.x boards for DroneBridge for ESP32 is connected to the USB-C port. 
            By using this port a ground station can connect to the ESP32 without the use of an UART-to-USB adapter.
            Intended for use on ground station ESP32 units directly connected to a GCS computer via USB.
            Requires ESP_CONSOLE_SECONDARY_NONE set to yes.
            WARNING: No logging available via USB port when USB/JTAG option is selected. Use debugging UART0 as specified by console settings for logging and diagnostics.
        config DB_SERIAL_OPTION_UART
            bool "UART"
            help
                Use the UART specified in the web interface for serial communication.
        config DB_SERIAL_OPTION_JTAG
            bool "USB/JTAG"
			depends on ESP_CONSOLE_SECONDARY_NONE
            help
                Use the JTAG interface for serial communication. 
                This interface is attached to the USB port of the official DroneBridge for ESP32 PCB in HW v1.x versions.
                A ground control station can connect to the USB port directly without having to use a FTDI in between.
                Not intended for connecting to a UAV etc. Use native UART instead.
                WARNING: No logging available via USB port.
    endchoice

    choice WEB_DEPLOY_MODE
        prompt "Website deploy mode"
        default WEB_DEPLOY_SF
        help
            Select website deploy mode.
            You can deploy website to host, and ESP32 will retrieve them in a semihost way (JTAG is needed).
            You can deploy website to SD card or SPI flash, and ESP32 will retrieve them via SDIO/SPI interface.
            Detailed operation steps are listed in the example README file.
        config WEB_DEPLOY_SEMIHOST
            bool "Deploy website to host (JTAG is needed)"
            help
                Deploy website to host.
                It is recommended to choose this mode during developing.
        config WEB_DEPLOY_SF
            bool "Deploy website to SPI Nor Flash"
            help
                Deploy website to SPI Nor Flash.
                Choose this in production mode or if the size of website is small (less than 2MB).
        config WEB_DEPLOY_EMBEDDED
            bool "Embed website in the application image"
            help
                Build the frontend into the application image. Firmware and web UI
                are then updated atomically through the normal OTA slot, so there is
                no separate web partition that can drift out of step with the code.
    endchoice

    if WEB_DEPLOY_SEMIHOST
        config HOST_PATH_TO_MOUNT
            string "Host path to mount (e.g. absolute path to web dist directory)"
            default "PATH-TO-WEB-DIST_DIR"
            help
                When using semihost in ESP32, you should specify the host path which will be mounted to VFS.
                Note that only absolute path is acceptable.
    endif

    config WEB_MOUNT_POINT
        string "Website mount point in VFS"
        default "/www"
        help
            Specify the mount point in VFS.

    choice DB_LOG_STORAGE
        prompt "Persistent log storage backend"
        default DB_LOG_STORAGE_LITTLEFS if IDF_TARGET_ESP32S3
        default DB_LOG_STORAGE_SPIFFS
        help
            Filesystem used for the partition labelled logs.

        config DB_LOG_STORAGE_LITTLEFS
            bool "LittleFS - power-fail safe (recommended)"
            help
                Store persistent logs using LittleFS on the partition labelled
                logs. LittleFS commits metadata atomically into CRC-protected
                metadata pairs, so a power cut leaves the previous valid state
                instead of stranding cluster chains: the orphaned-cluster
                failure mode does not exist. It also performs its own wear
                levelling directly on the partition, bypassing the ESP-IDF
                wear-levelling layer entirely.

                The partition is matched BY LABEL with ESP_PARTITION_SUBTYPE_ANY,
                so the partition table needs no change and the boat never has to
                be opened for a serial flash. See partitions_s3_16mb.csv.

        config DB_LOG_STORAGE_FATFS
            bool "FATFS with wear levelling - LEGACY, not power-fail safe"
            help
                The original layout: FATFS over the ESP-IDF wear-levelling layer.

                Kept only as a rollback. FAT has no journal, so a power cut
                during a metadata commit can strand cluster chains that nothing
                ever reclaims, and a cut during a wear-level sector move can
                erase FAT root-directory sectors outright (field-diagnosed
                20-08-2026; see db_sonar_log.c). ESP-IDF's power-safe
                WL_SECTOR_MODE_SAFE depends on WL_SECTOR_SIZE_512, which this
                build does not use, so no safe mode is available here.

        config DB_LOG_STORAGE_SPIFFS
            bool "SPIFFS - legacy"
            help
                The pre-FATFS layout. Retained for non-ESP32-S3 targets.

    endchoice

    config DB_DIAG_JOURNAL
        bool "Use the dedicated persistent diagnostic journal"
        default y if IDF_TARGET_ESP32S3
        default n
        help
            Store power-loss-safe, CRC32C-protected boot and lifecycle records
            in the partition labelled diag. One record occupies one erase
            sector so writes rotate evenly across the partition.

    config DB_DIAG_BENCH_CRASH_TEST
        bool "Expose destructive bench-only coredump test endpoints"
        depends on DB_DIAG_JOURNAL && ESP_COREDUMP_ENABLE_TO_FLASH
        default n
        help
            Adds endpoints that deliberately abort the firmware and erase the
            resulting coredump. Never enable this in a deployed build.

    config DB_OTA_HEALTH_GATE
        bool "Require the DBB post-OTA health gate"
        depends on BOOTLOADER_APP_ROLLBACK_ENABLE
        default n
        help
            Do not confirm a freshly booted OTA image until storage, the web UI,
            radio, control, the REST API, and FC/sonar where fitted have all
            reported healthy. Failure or timeout marks the image invalid and
            reboots into the previous slot.

            This depends on BOOTLOADER_APP_ROLLBACK_ENABLE for a reason: without
            it the bootloader never promotes an image to PENDING_VERIFY, so the
            gate can never arm and silently does nothing.

    config DB_OTA_HEALTH_TIMEOUT_SECONDS
        int "Pending OTA health-gate timeout in seconds"
        depends on DB_OTA_HEALTH_GATE
        range 60 3600
        default 600
        help
            Maximum time for every required health item to pass before the
            candidate is marked invalid and rollback is requested.

endmenu
```
